## sdkconfig.defaults
```kconfig
CONFIG_ESPTOOLPY_FLASHSIZE_4MB=y
CONFIG_ESPTOOLPY_FLASHSIZE="4MB"
CONFIG_PARTITION_TABLE_CUSTOM=y
CONFIG_PARTITION_TABLE_CUSTOM_FILENAME="partitions_example.csv"
CONFIG_PARTITION_TABLE_FILENAME="partitions_example.csv"

# Power Management (was enabled in sdkconfig.back)
# CONFIG_PM_ENABLE is not set
# CONFIG_PM_SLP_IRAM_OPT is not set

# FreeRTOS
CONFIG_FREERTOS_HZ=100

# mDNS
CONFIG_MDNS_MAX_SERVICES=10
# CONFIG_MDNS_NETWORKING_SOCKET is not set

# USJ
# CONFIG_USJ_NO_AUTO_LS_ON_CONNECTION is not set

CONFIG_ESP_PHY_PLL_TRACK_PERIOD_MS=1000

# Software decoder optimized for a 32-bit CPU, retaining RGB565 output.
# CONFIG_JD_USE_ROM is not set
CONFIG_JD_FORMAT_RGB565=y
CONFIG_JD_FASTDECODE_32BIT=y
CONFIG_COMPILER_OPTIMIZATION_SIZE=y
# CONFIG_ESP_CONSOLE_UART_DEFAULT is not set
# CONFIG_ESP_CONSOLE_USB_SERIAL_JTAG is not set
# CONFIG_ESP_CONSOLE_UART_CUSTOM is not set
CONFIG_ESP_CONSOLE_NONE=y
CONFIG_ESP_CONSOLE_SECONDARY_NONE=y
# CONFIG_ESP_CONSOLE_SECONDARY_USB_SERIAL_JTAG is not set
# CONFIG_HTTPD_WS_SUPPORT is not set
```
